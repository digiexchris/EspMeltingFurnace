## Frontend/sdkconfig.defaults
```kconfig
CONFIG_IDF_TARGET="esp32"
CONFIG_ESPTOOLPY_FLASHSIZE_4MB=y
CONFIG_LV_USE_OBSERVER=y
CONFIG_LV_THEME_DEFAULT_DARK=y
CONFIG_LV_USE_SYSMON=y
CONFIG_LV_USE_PERF_MONITOR=y
CONFIG_ESP_LCD_TOUCH_MAX_POINTS=1
CONFIG_ESP_LCD_TOUCH_MAX_BUTTONS=0
CONFIG_XPT2046_Z_THRESHOLD=600
CONFIG_LV_FONT_MONTSERRAT_18=y
CONFIG_LV_FONT_MONTSERRAT_32=y
CONFIG_LV_FONT_MONTSERRAT_36=y
CONFIG_LV_OS_FREERTOS=y
CONFIG_LV_USE_FREERTOS_TASK_NOTIFY=y

CONFIG_LV_USE_ASSERT_NULL=y
CONFIG_LV_USE_ASSERT_MALLOC=y
CONFIG_LV_USE_ASSERT_STYLE=y
CONFIG_LV_USE_ASSERT_MEM_INTEGRITY=y
CONFIG_LV_USE_ASSERT_OBJ=y

CONFIG_ETH_USE_ESP32_EMAC=n
CONFIG_ETH_USE_SPI_ETHERNET=n
CONFIG_ETH_USE_OPENETH=n

CONFIG_COMPILER_CXX_RTTI=y
CONFIG_LWIP_SO_RCVBUF=y
```

## Server/components/ftxui/Kconfig
```kconfig
menu "FTXUI Configuration"
    config FTXUI_MEMORY_LIMIT
        int "Maximum memory for FTXUI components (KB)"
        default 100
        help
            This sets the memory limit for FTXUI components.
endmenu
```

## Server/sdkconfig.defaults
```kconfig
CONFIG_IDF_TARGET="esp32"
CONFIG_ESPTOOLPY_FLASHSIZE_4MB=y

CONFIG_ETH_USE_ESP32_EMAC=n
CONFIG_ETH_USE_SPI_ETHERNET=n
CONFIG_ETH_USE_OPENETH=n

CONFIG_COMPILER_CXX_RTTI=y
CONFIG_LWIP_SO_RCVBUF=y

CONFIG_COMPILER_CXX_EXCEPTIONS=y
CONFIG_ESP_SYSTEM_PANIC_REBOOT_DELAY_SECONDS=5
CONFIG_ESP_MAIN_TASK_STACK_SIZE=16384
CONFIG_FREERTOS_IDLE_TASK_STACKSIZE=2048
```
